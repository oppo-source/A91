## kernel-4.4/drivers/misc/mediatek/geniezone/Kconfig
```kconfig
config MTK_GZ_KREE
	bool "MediaTek GenieZone support"
	depends on MTK_ENABLE_GENIEZONE
	default y
	help
	  Mediatek GenieZone kernel driver
	  with APIs based on MTEE framework
	  Note that user-space API requires
	  This module to be enabled.

config GZ_SUPPORT_SDSP
	bool "GenieZone support SDSP"
	depends on MTK_GZ_KREE
	default n
	help
	  GZ smcall into mtee for sdsp on and off.
	  When switch normal/secure vpu, need add
	  smc call into mtee for setup security
	  realted register.
```

## kernel-4.4/drivers/misc/mediatek/usb_c/Kconfig
```kconfig
#
# MediaTek USB USB TYPEC Driver
#

config USB_C_SWITCH
	bool "USB TYPE-C Driver"
	default n
	---help---
	  Enables to support usb-c. So the usb device and host driver register
	  the callback func to the usb-c driver. When the usb-c driver detect
	  a device/host plugged in/out, it will notify the device/host driver
	  by callback func.
	  If unsure, say N.

config USB_C_SWITCH_FUSB302
	bool "MediaTek USB TYPE-C Driver with external solution (FUSB302)"
	default n
	select USB_C_SWITCH
	---help---
	  Enable to support usb-c.
	  usb-c is supported by fusb302 and fusb340 and redriver.
	  Only supports CC detect, without PD.
	  And support DRP, aka UFP and DFP mode.
	  If unsure, say N.

config USB_C_SWITCH_SII70XX
	bool "MediaTek USB TYPE-C Driver with external solution (sii70xx)"
	default n
	select USB_C_SWITCH
	---help---
	  Enable to support usb-c.
	  usb-c is supported by Sii7033 and redriver.
	  Sii7033 supports CC detect, PD and MHL alt mode.
	  And support DRP, aka UFP and DFP mode.
	  If unsure, say N.

config USB_C_SWITCH_SII70XX_MHL_MODE
	bool "MediaTek USB TYPE-C Driver with external solution (sii70xx MHL Mode)"
	default n
	---help---
	  Enable to support usb-c MHL Mode.
	  usb-c is supported by Sii7033 and redriver.
	  Sii7033 MHL Mode supports only MHL alt mode.
	  If unsure, say N.

config USB_C_SWITCH_ANX7418
	bool "Analogix Type-C interface support"
	default n
	select USB_C_SWITCH
	---help---
	  Enable to support usb-c.
	  usb-c is supported by ANX7418.
	  ANX7418 supports CC detect, PD and DP alt mode.
	  And support DRP, aka UFP and DFP mode.
	  If unsure, say N.

config USB_C_SWITCH_MT6336
	bool "MediaTek USB TYPE-C Driver (MT6336)"
	default n
	select USB_C_SWITCH
	---help---
	  Enables MT6336 supporting USB TYPE-C & PD.
	  MT6336 can communicate with the partner
	  and cable by attached CC pin.
	  Also can be SRC/SNK and DFP/UFP. It is
	  a dual role port.
	  If unsure, say N.

config USB_C_SWITCH_MT6392
	bool "MediaTek USB TYPE-C Driver (MT6392)"
	depends on MFD_MT6397
	select USB_C_SWITCH
	---help---
	  Enables MT6392 supporting USB TYPE-C only.
	  MT6392 can communicate with the partner
	  and cable by attached CC pin.
	  Also can be SRC/SNK and DFP/UFP. It is
	  a dual role port.
	  If unsure, say N.

config USB_C_SWITCH_U3_MUX
	bool "USB TYPE-C USB 3.0 Mux"
	default n
	---help---
	  Enables to support USB3.0 mux in usb-c.
	  To support TYPE-C USB3.0 must have a MUX to switch SSRX1/SSTX1/SSRX2/SSTX2 pins.
	  Say Y to enable TYPEC USB3.0 Mux
	  If unsure, say N.

source "drivers/misc/mediatek/usb_c/tcpc/Kconfig"
```

## kernel-4.4/drivers/soc/oppo/Kconfig
```kconfig
#ifdef VENDOR_EDIT
# Bin.Li@EXP.BSP.bootloader.bootflow, 2017/05/15, Add for config oppo software common soft
config OPPO_ARCH_FILE
    bool "for build directory oppo"
    ---help---
    say Y to buid in

config OPPO_COMMON_SOFT
        bool "config oppo common software"
        select OPPO_ARCH_FILE
        help
        define this config to get project verion from sharemem.
        Maybe this value is from CDT or dynamic identify by hardware
        id.

config OPPO_DEVICE_IFNO
        bool "config oppo devinfo"
        select OPPO_ARCH_FILE
        help
        define this config to compile devinfo.c for device register.

source "drivers/soc/oppo/oppo_project/Kconfig"
source "drivers/soc/oppo/oppo_devinfo/Kconfig"

#ifdef VENDOR_EDIT
# Bin.Li@EXP.BSP.bootloader.bootflow, 2017/05/15, Add for critical_log
source "drivers/soc/oppo/oppo_criticallog/Kconfig"
#endif /* VENDOR_EDIT */

#ifdef VENDOR_EDIT

# Bin.Li@EXP.BSP.bootloader.bootflow, 2017/05/15 Add hypnus helper
source "drivers/soc/oppo/oppo_hypnus/Kconfig"
#endif /* VENDOR_EDIT */

#ifdef VENDOR_EDIT
#//wenbin.liu@PSW.Kernel.MM, 2018/05/23, Add for Healthinfo monitor
source "drivers/soc/oppo/oppo_healthinfo/Kconfig"
#endif /* VENDOR_EDIT */

#endif /* VENDOR_EDIT */

#ifdef VENDOR_EDIT
#//Kun.Hu@PSW.TECH 2018/11/15, Add phoenix base
#source "drivers/soc/oppo/oppo_phoenix/Kconfig"
#endif /* VENDOR_EDIT */

#ifdef VENDOR_EDIT
#//qiuzuolin@PSW.BSP.Sensor , 2018-05-15,Add for light sensor cali
source "drivers/soc/oppo/oppo_als_cali_value/Kconfig"
#endif /* VENDOR_EDIT */

#ifdef VENDOR_EDIT
#* wen.luo@PSW.BSP.kernel, 2019/6/25, Add for parsar powoff/powon */
source "drivers/soc/oppo/oppo_lastpmic/Kconfig"

#//Wen.Luo@BSP
#Liang.Zhang@TECH.Storage.Stability.OPPO_SHUTDOWN_DETECT, 2019/04/28, Add for shutdown detect
source "drivers/soc/oppo/oppo_shutdown_detect/Kconfig"

#endif /* VENDOR_EDIT */
```

## kernel-4.4/drivers/soc/oppo/oppo_lastpmic/Kconfig
```kconfig
# ifdef VENDOR_EDIT
#* wen.luo@PSW.BSP.kernel, 2019/6/25, Add for parsar powoff/powon */
config OPPO_LAST_PMIC
	bool "config oppo last pmic"
	help
	  define this config to parsar last poff reason.
#endif /* VENDOR_EDIT */
```

## kernel-4.4/drivers/soc/oppo/oppo_phoenix/Kconfig
```kconfig
# ifdef VENDOR_EDIT
#//Kun.Hu@PSW.TECH 2018/11/15, Add phoenix base
config PHOENIX_BASE
bool "config phoenix base"
help
    Provide base functions for phoenix.
#endif /* VENDOR_EDIT */
```
